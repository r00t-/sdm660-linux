// SPDX-License-Identifier: GPL-2.0-only
/*
 * Copyright (c) 2025, Paul Sajna <hello@paulsajna.com>
 */

/dts-v1/;

#include "sdm660-bbry-athena-common.dtsi"

/ {
	compatible = "bbry,athena-syna", "qcom,sdm660";
};

&panel {
	compatible = "syna,td4300-panel";

	vio-supply = <&vreg_l9a_1p8>;
	vsn-supply = <&lcdb_dummy>;
	vsp-supply = <&lcdb_dummy>;

	panel-timing {
		clock-frequency = <127280160>;
		hactive = <1080>;
		hsync-len = <2>;
		hfront-porch = <120>;
		hback-porch = <40>;

		vactive = <1620>;
		vsync-len = <2>;
		vfront-porch = <8>;
		vback-porch = <6>;
	};
};
